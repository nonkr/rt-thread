## bsp/stm32/stm32f103rc-minimal/applications/Kconfig
```kconfig
menu "User Applications Config"

menu "Application Samples"

    menuconfig APP_USING_SAMPLES
        config APP_USING_PWM_LED
            bool "Enable PWM LED sample"
            default n

        config APP_USING_LED
            bool "Enable LED sample"
            default n

endmenu

endmenu
```

## bsp/stm32/stm32f103rc-minimal/board/Kconfig
```kconfig
menu "Hardware Drivers Config"

config SOC_STM32F103RC
    bool
    select SOC_SERIES_STM32F1
    default y

menu "Onboard Peripheral Drivers"

endmenu

menu "On-chip Peripheral Drivers"

    config BSP_USING_GPIO
        bool "Enable GPIO"
        select RT_USING_PIN
        default y

    menuconfig BSP_USING_UART
        bool "Enable UART"
        default y
        select RT_USING_SERIAL
        if BSP_USING_UART
            config BSP_USING_UART1
                bool "Enable UART1"
                default y

            config BSP_UART1_RX_USING_DMA
                bool "Enable UART1 RX DMA"
                depends on BSP_USING_UART1 && RT_SERIAL_USING_DMA
                default n

            config BSP_USING_UART2
                bool "Enable UART2"
                default n

            config BSP_UART2_RX_USING_DMA
                bool "Enable UART2 RX DMA"
                depends on BSP_USING_UART2 && RT_SERIAL_USING_DMA
                default n

            config BSP_USING_UART3
                bool "Enable UART3"
                default n

            config BSP_UART3_RX_USING_DMA
                bool "Enable UART3 RX DMA"
                depends on BSP_USING_UART3 && RT_SERIAL_USING_DMA
                default n
        endif

    menuconfig BSP_USING_SPI
        bool "Enable SPI BUS"
        default n
        select RT_USING_SPI
        if BSP_USING_SPI
            config BSP_USING_SPI1
                bool "Enable SPI1 BUS"
                default n

            config BSP_SPI1_TX_USING_DMA
                bool "Enable SPI1 TX DMA"
                depends on BSP_USING_SPI1
                default n
                
            config BSP_SPI1_RX_USING_DMA
                bool "Enable SPI1 RX DMA"
                depends on BSP_USING_SPI1
                select BSP_SPI1_TX_USING_DMA
                default n

            config BSP_USING_SPI2
                bool "Enable SPI2 BUS"
                default n

            config BSP_SPI2_TX_USING_DMA
                bool "Enable SPI2 TX DMA"
                depends on BSP_USING_SPI2
                default n
                
            config BSP_SPI2_RX_USING_DMA
                bool "Enable SPI2 RX DMA"
                depends on BSP_USING_SPI2
                select BSP_SPI2_TX_USING_DMA
                default n
        endif

    menuconfig BSP_USING_I2C1
        bool "Enable I2C1 BUS (software simulation)"
        default n
        select RT_USING_I2C
        select RT_USING_I2C_BITOPS
        select RT_USING_PIN
        if BSP_USING_I2C1
            config BSP_I2C1_SCL_PIN
                int "i2c1 scl pin number"
                range 1 216
                default 15
            config BSP_I2C1_SDA_PIN
                int "I2C1 sda pin number"
                range 1 216
                default 16
        endif

    menuconfig BSP_USING_PWM1
        bool "Using PWM1"
        select RT_USING_PWM
        default n

        if BSP_USING_PWM1
            config BSP_USING_PWM1_CH1
                bool "Enable Channel 1 (PA8)"
                default n
            config BSP_USING_PWM1_CH2
                bool "Enable Channel 2 (PA9)"
                default n
            config BSP_USING_PWM1_CH3
                bool "Enable Channel 3 (PA10)"
                default n
            config BSP_USING_PWM1_CH4
                bool "Enable Channel 4 (PA11)"
                default n
        endif

    menuconfig BSP_USING_PWM2
        bool "Using PWM2"
        select RT_USING_PWM
        default n

        if BSP_USING_PWM2
            config BSP_USING_PWM2_CH1
                bool "Enable Channel 1 (PA5)"
                default n
            config BSP_USING_PWM2_CH2
                bool "Enable Channel 2 (PB3)"
                default n
            config BSP_USING_PWM2_CH3
                bool "Enable Channel 3 (PB10)"
                default n
            config BSP_USING_PWM2_CH4
                bool "Enable Channel 4 (PA3)"
                default n
        endif

endmenu

menu "Board extended module Drivers"

endmenu

endmenu
```
